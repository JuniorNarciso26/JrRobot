## experiments/esp-wifi-service/wifi_service_example/sdkconfig.defaults
```kconfig
CONFIG_ESP_MCP_ENABLE=n
CONFIG_WIFI_SERVICE_MCP_ENABLE=n

# Synced from wifi_demo defaults
CONFIG_PARTITION_TABLE_CUSTOM=y
CONFIG_PARTITION_TABLE_CUSTOM_FILENAME="partitions.csv"

CONFIG_ESP_WIFI_IRAM_OPT=n
CONFIG_ESP_WIFI_RX_IRAM_OPT=n

CONFIG_MBEDTLS_KEY_EXCHANGE_DHE_RSA=y
CONFIG_MBEDTLS_DHM_C=y

CONFIG_ESP_MAIN_TASK_STACK_SIZE=8192
CONFIG_ESP_SYSTEM_EVENT_TASK_STACK_SIZE=4096


# JrBot laboratory: HTTP provisioning only
CONFIG_WIFI_SERVICE_PROV_HTTP_ENABLE=y
CONFIG_WIFI_SERVICE_PROV_HTTP_DEFAULT_WEBUI_ENABLE=y
CONFIG_WIFI_SERVICE_PROV_BLUFI_ENABLE=n
```

## firmware/main/Kconfig.projbuild
```kconfig
menu "JrBot V2 - hardware"
    comment "HW04 final profile: OLED SSD1306 + OV5640 + MAX98357A + MS3625 are enabled"
endmenu
```

## wire_test/sdkconfig.defaults
```kconfig
CONFIG_ESPTOOLPY_FLASHSIZE_16MB=y
CONFIG_ESPTOOLPY_FLASHSIZE="16MB"
CONFIG_ESPTOOLPY_FLASHFREQ_80M=y
CONFIG_ESPTOOLPY_FLASHMODE_QIO=y
CONFIG_ESP_DEFAULT_CPU_FREQ_MHZ_240=y
CONFIG_FREERTOS_HZ=1000

# Console principal no UART0. USB Serial/JTAG fica exclusiva para o terminal de teste.
CONFIG_ESP_CONSOLE_UART_DEFAULT=y
# CONFIG_ESP_CONSOLE_USB_CDC is not set
# CONFIG_ESP_CONSOLE_USB_SERIAL_JTAG is not set
# CONFIG_ESP_CONSOLE_UART_CUSTOM is not set
# CONFIG_ESP_CONSOLE_NONE is not set
CONFIG_ESP_CONSOLE_SECONDARY_NONE=y
# CONFIG_ESP_CONSOLE_SECONDARY_USB_SERIAL_JTAG is not set

CONFIG_ESP_MAIN_TASK_STACK_SIZE=4096
```
